## boards/st/f407/Kconfig.defconfig
```kconfig
# Copyright (c) 2024 nanoWAys
# SPDX-License-Identifier: Apache-2.0

if BOARD_NANOWAYS_F407

config SPI_STM32_INTERRUPT
	default y
	depends on SPI

endif # BOARD_NANOWAYS_F407
```

## boards/st/f407/Kconfig.nanoways_f407
```kconfig
# Copyright (c) 2024 nanoWAys
# SPDX-License-Identifier: Apache-2.0

config BOARD_NANOWAYS_F407
	select SOC_STM32F407XE
```

## boards/st/f407/board.yml
```yaml
board:
  name: nanoways_f407
  full_name: nanoWAys STM32F407VET6 Water Quality Analyzer
  vendor: nanoways
  socs:
    - name: stm32f407xx
```
